## esp32s3-example/main/Kconfig.projbuild
```kconfig
menu "EdgeTTS Client Configuration"

    config WIFI_SSID
        string "WiFi SSID"
        default "your_wifi_ssid"
        help
            SSID (network name) to connect to.

    config WIFI_PASSWORD
        string "WiFi Password"
        default "your_wifi_password"
        help
            WiFi password (WPA or WPA2).

    config EDGETTS_SERVER_HOST
        string "EdgeTTS Server Host"
        default "192.168.1.100"
        help
            EdgeTTS server IP address or hostname.

    config EDGETTS_SERVER_PORT
        int "EdgeTTS Server Port"
        default 3003
        help
            EdgeTTS server port number.

endmenu
```

## esp32s3-example/sdkconfig.defaults
```kconfig
# 分区表配置
CONFIG_PARTITION_TABLE_CUSTOM=y
CONFIG_PARTITION_TABLE_CUSTOM_FILENAME="partitions.csv"
CONFIG_PARTITION_TABLE_FILENAME="partitions.csv"

# 编译优化
CONFIG_COMPILER_OPTIMIZATION_SIZE=y

# WiFi配置
CONFIG_ESP_WIFI_STATIC_RX_BUFFER_NUM=10
CONFIG_ESP_WIFI_DYNAMIC_RX_BUFFER_NUM=32
CONFIG_ESP_WIFI_DYNAMIC_TX_BUFFER_NUM=32

# HTTP配置
CONFIG_ESP_HTTP_CLIENT_ENABLE_HTTPS=y
CONFIG_MBEDTLS_CERTIFICATE_BUNDLE=y

# 日志级别
CONFIG_LOG_DEFAULT_LEVEL_INFO=y

# Flash大小 (根据你的板子调整)
CONFIG_ESPTOOLPY_FLASHSIZE_8MB=y
CONFIG_ESPTOOLPY_FLASHSIZE="8MB"
```
